/ {
    right_encoder: encoder_right {
            compatible = "alps,ec11";
            label = "RIGHT_ENCODER";
            a-gpios = <&gpio0 14 (GPIO_ACTIVE_HIGH | GPIO_PULL_UP)>;
            b-gpios = <&gpio0 15 (GPIO_ACTIVE_HIGH | GPIO_PULL_UP)>;
            resolution = <4>;
        };

    sensors {
        compatible = "zmk,keymap-sensors";
        sensors = <&right_encoder>;
    };
};